## Kconfig
```kconfig
menu "Utils"

choice DEBUG_UART
  prompt "UART used for debug messages"
  default DEBUG_UART1

  config DEBUG_UART1
    bool "huart1"
  config DEBUG_UART2
    bool "huart2"
  config DEBUG_UART3
    bool "huart3"
  config DEBUG_UART4
    bool "huart4"
  config DEBUG_UART5
    bool "huart5"
endchoice

endmenu
```
